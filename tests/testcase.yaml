## tests/testcase.yaml
```yaml
tests:
  testing.ztest:
    platform_allow:
      - qemu_cortex_m3
    tags: unit
```

## tests/unit/math_lib/testcase.yaml
```yaml
tests:
  unit.math_lib:
    type: unit
    platform_allow:
      - nucleo_f411re
      - qemu_cortex_m3
```
